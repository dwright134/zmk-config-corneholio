## boards/shields/corneholio/Kconfig.defconfig
```kconfig
if SHIELD_CORNEHOLIO_LEFT
  config ZMK_KEYBOARD_NAME
    default "Corneholio"
  config ZMK_SPLIT_ROLE_CENTRAL
    default y
endif

if SHIELD_CORNEHOLIO_LEFT || SHIELD_CORNEHOLIO_RIGHT
  config ZMK_SPLIT
    default y
  config ZMK_SPLIT_BLE
    default y
endif
```

## boards/shields/corneholio/Kconfig.shield
```kconfig
config SHIELD_CORNEHOLIO_LEFT
  def_bool $(shields_list_contains, corneholio_left)

config SHIELD_CORNEHOLIO_RIGHT
  def_bool $(shields_list_contains, corneholio_right)
```
